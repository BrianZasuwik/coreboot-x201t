## defconfig
```kconfig
CONFIG_VENDOR_LENOVO=y
CONFIG_CBFS_SIZE=0x300000
CONFIG_LINEAR_FRAMEBUFFER_MAX_HEIGHT=800
CONFIG_LINEAR_FRAMEBUFFER_MAX_WIDTH=1280
CONFIG_IFD_BIN_PATH="3rdparty/blobs/mainboard/lenovo/x201/descriptor.bin"
CONFIG_ME_BIN_PATH="3rdparty/blobs/mainboard/lenovo/x201/me.bin"
CONFIG_GBE_BIN_PATH="3rdparty/blobs/mainboard/lenovo/x201/gbe.bin"
CONFIG_HAVE_IFD_BIN=y
CONFIG_BOARD_LENOVO_X201=y
CONFIG_EDK2_BOOTSPLASH_FILE="3rdparty/blobs/mainboard/lenovo/x201/logo.bmp"
CONFIG_H8_SUPPORT_BT_ON_WIFI=y
CONFIG_HAVE_ME_BIN=y
CONFIG_CHECK_ME=y
CONFIG_HAVE_GBE_BIN=y
# CONFIG_TPM_PPI is not set
CONFIG_PAYLOAD_EDK2=y
CONFIG_BMP_LOGO=y
CONFIG_BMP_LOGO_FILE_NAME="3rdparty/blobs/mainboard/lenovo/x201/logo.bmp"
```
